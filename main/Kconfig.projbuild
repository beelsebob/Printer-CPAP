## main/Kconfig.projbuild
```kconfig
menu "Printer-CPAP"
    choice PCP_HW_IN_USE
        prompt "What hardware are we running on"
        default PCP_HW_M5_BASIC
        config PCP_HW_M5_BASIC
            bool "M5Stack Basic"
            imply LV_FONT_MONTSERRAT_48
        config PCP_HW_M5_CORE2
            bool "M5Stack Core 2"
            imply LV_FONT_MONTSERRAT_48
        config PCP_HW_GENERIC
            bool "Generic ESP32"
    endchoice
endmenu
```

## sdkconfig.defaults
```kconfig
# CONFIG_PCP_HW_M5_BASIC is not set
# CONFIG_PCP_HW_M5_CORE2 is not set
# CONFIG_PCP_HW_M5_CORES3 is not set
# CONFIG_PCP_HW_GENERIC is not set

# increased stack size
CONFIG_ESP_SYSTEM_EVENT_TASK_STACK_SIZE=6000
CONFIG_ESP_MAIN_TASK_STACK_SIZE=16384
CONFIG_ESP_MINIMAL_SHARED_STACK_SIZE=4096

# timer dispatch
CONFIG_ESP_TIMER_SUPPORTS_ISR_DISPATCH_METHOD=y

# lvgl
CONFIG_LV_FONT_MONTSERRAT_18=y
CONFIG_LV_FONT_MONTSERRAT_24=y
CONFIG_LV_FONT_MONTSERRAT_44=y
CONFIG_LV_FONT_DEFAULT_MONTSERRAT_24=y

# CONFIG_LV_USE_ANIMIMG is not set
CONFIG_LV_USE_ARC=y
CONFIG_LV_USE_BAR=y
CONFIG_LV_USE_BUTTON=y
# CONFIG_LV_USE_BUTTONMATRIX is not set
# CONFIG_LV_USE_CALENDAR is not set
# CONFIG_LV_USE_CANVAS is not set
# CONFIG_LV_USE_CHART is not set
# CONFIG_LV_USE_CHECKBOX is not set
# CONFIG_LV_USE_DROPDOWN is not set
CONFIG_LV_USE_IMAGE=y
# CONFIG_LV_USE_IMAGEBUTTON is not set
# CONFIG_LV_USE_KEYBOARD is not set
CONFIG_LV_USE_LABEL=y
# CONFIG_LV_LABEL_TEXT_SELECTION is not set
# CONFIG_LV_LABEL_LONG_TXT_HINT is not set
CONFIG_LV_LABEL_WAIT_CHAR_COUNT=3
# CONFIG_LV_USE_LED is not set
# CONFIG_LV_USE_LINE is not set
# CONFIG_LV_USE_LIST is not set
CONFIG_LV_USE_MENU=y
# CONFIG_LV_USE_MSGBOX is not set
CONFIG_LV_USE_ROLLER=y
# CONFIG_LV_USE_SCALE is not set
CONFIG_LV_USE_SLIDER=y
# CONFIG_LV_USE_SPAN is not set
# CONFIG_LV_USE_SPINBOX is not set
CONFIG_LV_USE_SPINNER=y
# CONFIG_LV_USE_SWITCH is not set
# CONFIG_LV_USE_TEXTAREA is not set
CONFIG_LV_USE_TABLE=y
# CONFIG_LV_USE_TABVIEW is not set
# CONFIG_LV_USE_TILEVIEW is not set
# CONFIG_LV_USE_WIN is not set

CONFIG_LV_THEME_DEFAULT_DARK=y

CONFIG_LV_USE_FLEX=y
# CONFIG_LV_USE_GRID is not set

# CONFIG_LV_BUILD_EXAMPLES is not set
# CONFIG_LV_BUILD_DEMOS is not set
```
